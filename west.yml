## west.yml
```yaml
# SPDX-License-Identifier: Apache-2.0

manifest:
  version: "0.13"

  remotes:
    - name: zephyrproject-rtos
      url-base: https://github.com/zephyrproject-rtos

  projects:
    - name: zephyr
      remote: zephyrproject-rtos
      revision: 8b9ade18ac6515114c3ef24cb067fb9aa94a7c63 # Use hash until needed changes in zephyr are on a tag
      import:
        name-allowlist:
          - cmsis_6
          - hal_st
          - hal_stm32
          - mbedtls
          - mcuboot

    - name: mender-mcu
      url: https://github.com/mendersoftware/mender-mcu
      revision: main
      path: modules/mender-mcu
      import: true

  self:
    path: seven-clicker-sample
```
